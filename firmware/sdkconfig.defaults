## firmware/sdkconfig.defaults
```kconfig
# esp32-gnssmqtt sdkconfig.defaults
# Kconfig overrides for ESP-IDF v5.3.3 / ESP32-C6

# Flash size — XIAO ESP32-C6 has 4MB flash; default is 2MB which rejects our partition table
CONFIG_ESPTOOLPY_FLASHSIZE="4MB"
CONFIG_ESPTOOLPY_FLASHSIZE_4MB=y

# Use our custom partition table instead of the ESP-IDF default (single-app at 0x10000)
CONFIG_PARTITION_TABLE_CUSTOM=y
CONFIG_PARTITION_TABLE_CUSTOM_FILENAME="../../../../../../partitions.csv"

# Main task stack — Rust std requires significantly more than the default 3KB
CONFIG_ESP_MAIN_TASK_STACK_SIZE=8000

# FreeRTOS stack overflow detection — Method 2 (canary bytes at stack end)
# Checks on every context switch; minimal performance overhead
CONFIG_FREERTOS_CHECK_STACKOVERFLOW_CANARY=y

# Console: USB-Serial-JTAG as primary console so stdin/stdout both go through
# the USB-C port that espflash monitor connects to. Without this, stdin reads
# go to UART0 (not connected on XIAO) and typing in the monitor has no effect.
CONFIG_ESP_CONSOLE_USB_SERIAL_JTAG=y

# Log level: INFO (3)
CONFIG_LOG_DEFAULT_LEVEL_INFO=y
CONFIG_LOG_DEFAULT_LEVEL=3

# UART RX ring buffer note:
# There is NO CONFIG_UART_RX_BUFFER_SIZE Kconfig option in ESP-IDF v5.
# The UART RX ring buffer size is set at runtime via uart_driver_install().
# Phase 2 MUST pass rx_buffer_size >= 4096 (see src/config.rs UART_RX_BUF_SIZE).

# OTA: enable bootloader rollback — new firmware must call mark_running_slot_valid()
# or the bootloader rolls back to the previous slot on the next reboot.
CONFIG_BOOTLOADER_APP_ROLLBACK_ENABLE=y

# OTA: extend task watchdog to 30s to survive partition erase (takes 4-8s on ESP32-C6).
# The default 5s fires during EspOta::initiate_update() which erases the full ~1.875MB slot.
CONFIG_ESP_TASK_WDT_TIMEOUT_S=30
# Software WDT (Phase 11) catches hangs in 15s (3 × 5s); hardware TWDT fires at 30s as backstop.
# CONFIG_ESP_TASK_WDT_PANIC=y makes TWDT fatal — reboots if the supervisor itself hangs
# (idle task stops being scheduled). Without this, TWDT only logs (no reboot).
CONFIG_ESP_TASK_WDT_PANIC=y

# HTTP server: increase header buffer so Android/desktop browsers don't get 431.
# Default is 512 bytes; Android Chrome sends User-Agent + cookies that exceed this.
CONFIG_HTTPD_MAX_REQ_HDR_LEN=1024

# Log timestamps: use system time (wall clock) instead of RTOS ticks.
# After SNTP syncs, log lines show HH:MM:SS.mmm instead of uptime ms.
# Requires EspSntp to be initialised at runtime (see main.rs Step 6.5).
CONFIG_LOG_TIMESTAMP_SOURCE_SYSTEM=y

# MQTT outbox limits
# OUTBOX_EXPIRED_TIMEOUT_MS: restore to 30s default. The 5s value caused silent expiry of
# queued QoS-0 messages when drain rate (50 msg/s at 20ms poll) couldn't keep up with bursts.
# Heap growth is capped instead by OUTBOX_SIZE_BYTES below.
# OUTBOX_SIZE_BYTES: hard byte cap on outbox heap (~16 KB ≈ 200 NMEA sentences).
# When exceeded, enqueue() returns -2 → publish_thread increments MQTT_OUTBOX_DROPS.
# This is more reliable than MQTT_REPORT_DELETED_MESSAGES which has a bug where
# QoS-0 expiry events never fire (msg_id=0 fails the `while (msg_id > 0)` loop condition).
CONFIG_MQTT_OUTBOX_EXPIRED_TIMEOUT_MS=30000
CONFIG_MQTT_OUTBOX_SIZE_BYTES=16384

# MQTT publish throughput
# MQTT_USE_CUSTOM_CONFIG is required — POLL_READ_TIMEOUT and EVENT_QUEUE_SIZE both
# depend on it in Kconfig; without it they silently stay at defaults (1000ms, 1).
# POLL_READ_TIMEOUT_MS=20: 50 msg/s drain rate — headroom for 5 Hz × 10 sentences/epoch.
# EVENT_QUEUE_SIZE=10: enables max_poll_timeout() fast-path (10ms when queued_events>0)
# but note queued_events only increments for custom events, not outbox publishes —
# so the fast-path does not apply to our QoS-0 publish path.
CONFIG_MQTT_USE_CUSTOM_CONFIG=y
CONFIG_MQTT_POLL_READ_TIMEOUT_MS=20
CONFIG_MQTT_EVENT_QUEUE_SIZE=10
```

## sdkconfig.defaults
```kconfig
# esp32-gnssmqtt sdkconfig.defaults
# Kconfig overrides for ESP-IDF v5.3.3 / ESP32-C6

# Flash size — XIAO ESP32-C6 has 4MB flash; default is 2MB which rejects our partition table
CONFIG_ESPTOOLPY_FLASHSIZE="4MB"
CONFIG_ESPTOOLPY_FLASHSIZE_4MB=y

# Use our custom partition table instead of the ESP-IDF default (single-app at 0x10000)
CONFIG_PARTITION_TABLE_CUSTOM=y
CONFIG_PARTITION_TABLE_CUSTOM_FILENAME="../../../../../../partitions.csv"

# Main task stack — Rust std requires significantly more than the default 3KB
CONFIG_ESP_MAIN_TASK_STACK_SIZE=8000

# FreeRTOS stack overflow detection — Method 2 (canary bytes at stack end)
# Checks on every context switch; minimal performance overhead
CONFIG_FREERTOS_CHECK_STACKOVERFLOW_CANARY=y

# Console: USB-Serial-JTAG as primary console so stdin/stdout both go through
# the USB-C port that espflash monitor connects to. Without this, stdin reads
# go to UART0 (not connected on XIAO) and typing in the monitor has no effect.
CONFIG_ESP_CONSOLE_USB_SERIAL_JTAG=y

# Log level: INFO (3)
CONFIG_LOG_DEFAULT_LEVEL_INFO=y
CONFIG_LOG_DEFAULT_LEVEL=3

# UART RX ring buffer note:
# There is NO CONFIG_UART_RX_BUFFER_SIZE Kconfig option in ESP-IDF v5.
# The UART RX ring buffer size is set at runtime via uart_driver_install().
# Phase 2 MUST pass rx_buffer_size >= 4096 (see src/config.rs UART_RX_BUF_SIZE).
```
